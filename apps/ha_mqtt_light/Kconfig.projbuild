## apps/ha_mqtt_light/Kconfig.projbuild
```kconfig
menu "Home Assistant MQTT Light configuration"
    config HA_LIGHT_MQTT_BROKER_URL
        string "MQTT broker URL"
        default "mqtt://192.168.1.3"

    config HA_LIGHT_DISCOVERY_PREFIX
        string "Home Assistant discovery topic prefix"
        default "homeassistant"
        help
            Discovery topic prefix, must match one in the HA settings

    config HA_LIGHT_DEVICE_NAME
        string "Device name"
        default "HackyClock"
        help
            Device name, displayed inside the HA settings

    config HA_LIGHT_OBJECT_NAME
        string "Light object name"
        default "Screen"
        help
            Object name in Home Assistant

    config HA_LIGHT_ORIGIN_NAME
        string "Origin name"
        default "HackyClock"
        help
            Origin of MQTT device, somehow a mandatory, just an internal thing

    config HA_LIGHT_DEVICE_MANUFACTURER
        string "Device manufacturer"
        default ""
        help
            Manufacturer of device, displayed inside the HA settings

    config HA_LIGHT_BRIGHTNESS_STEP
        int "Brightness step"
        default 17
        help
            Brightness increase / decrease step for knob rotation
endmenu
```

## apps/weather/Kconfig.projbuild
```kconfig
menu "Weather app configuration"
    config WEATHER_LAT
        string "Latitude"
        default "55.7522"
    
    config WEATHER_LON
        string "Longtitude"
        default "37.6156"
    
    config WEATHER_FETCH_DELAY
        int "API fetch delay (seconds)"
        default 120
    
    config WEATHER_FETCH_RETRY_DELAY
        int "API fetch retry delay (seconds)"
        default 10
endmenu
```

## main/Kconfig.projbuild
```kconfig
menu "HackyClock configuration"
    menu "LED matrix"
        config HC_STRIP_GPIO
            int "LED strip data line GPIO"
            default 15
            help
                Number of GPIO, which is connected to the LED strip data pin

        choice HC_STRIP_LED_TYPE
            prompt "LED strip type"
            default HC_STRIP_LED_TYPE_WS2812
            config HC_STRIP_LED_TYPE_WS2812
                bool "WS2812"
            config HC_STRIP_LED_TYPE_SK6812
                bool "SK6812"
            config HC_STRIP_LED_TYPE_WS2811
                bool "WS2811"
        endchoice

        choice HC_STRIP_COLOR_ORDER
            prompt "LED strip color order"
            default HC_STRIP_COLOR_ORDER_GRB
            config HC_STRIP_COLOR_ORDER_GRB
                bool "GRB"
            config HC_STRIP_COLOR_ORDER_RGB
                bool "RGB"
        endchoice

        config HC_MATRIX_WIDTH
            int "Matrix width"
            default 16

        config HC_MATRIX_HEIGHT
            int "Matrix height"
            default 16

        choice HC_MATRIX_TYPE
            prompt "Matrix type"
            default HC_MATRIX_TYPE_SERPENTINE
            help
                Defines the type of connection between rows of LEDs
            config HC_MATRIX_TYPE_SERPENTINE
                bool "Serpentine"
            config HC_MATRIX_TYPE_PARALLEL
                bool "Parallel"
        endchoice

        choice HC_MATRIX_SERPENTINE_DIR
            prompt "First row direction"
            depends on HC_MATRIX_TYPE_SERPENTINE
            default HC_MATRIX_SERPENTINE_DIR_NORMAL
            help
                Whether data signal is connected to the left (normal) or right (inversed)
                side of the first row of matrix
            config HC_MATRIX_SERPENTINE_DIR_NORMAL
                bool "Normal"
            config HC_MATRIX_SERPENTINE_DIR_INVERSED
                bool "Inversed"
        endchoice

        config HC_FB_BRIGHTNESS
            int "Maximum brightness"
            default 255
            help
                Defines the maximum brightness of LEDs, in range 0-255
    endmenu

    menu "App manager"
        config HC_AM_MAX_APPS
            int "Maximum number of apps"
            default 8

        config HC_AM_SLIDE_FRAME_DELAY
            int "Delay between slide animation frames (in ms)"
            default 20
    endmenu

    menu "Wi-Fi"
        config HC_WIFI_SSID
            string "Wi-Fi SSID"
            help
                SSID (network name) to connect to.

        config HC_WIFI_PASSWD
            string "Wi-Fi Password"

        config HC_WIFI_MAX_RETRY
            int "Maximum retries count"
            default 3
            help
                Limits the number of connection attempts

        choice HC_WIFI_SCAN_AUTH_MODE_THRESHOLD
            prompt "Scan auth mode threshold"
            default HC_WIFI_AUTH_WPA2_PSK
            help
                The weakest authmode to accept in the scan mode.
                This value defaults to HC_WIFI_AUTH_WPA2_PSK incase password is present and HC_WIFI_AUTH_OPEN is used.
                Please select HC_WIFI_AUTH_WEP/HC_WIFI_AUTH_WPA_PSK incase AP is operating in WEP/WPA mode.

            config HC_WIFI_AUTH_OPEN
                bool "OPEN"
            config HC_WIFI_AUTH_WEP
                bool "WEP"
            config HC_WIFI_AUTH_WPA_PSK
                bool "WPA PSK"
            config HC_WIFI_AUTH_WPA2_PSK
                bool "WPA2 PSK"
            config HC_WIFI_AUTH_WPA_WPA2_PSK
                bool "WPA/WPA2 PSK"
            config HC_WIFI_AUTH_WPA3_PSK
                bool "WPA3 PSK"
            config HC_WIFI_AUTH_WPA2_WPA3_PSK
                bool "WPA2/WPA3 PSK"
            config HC_WIFI_AUTH_WAPI_PSK
                bool "WAPI PSK"
        endchoice
    endmenu
endmenu
```

## sdkconfig.defaults
```kconfig
CONFIG_ESPTOOLPY_FLASHSIZE_4MB=y
CONFIG_PARTITION_TABLE_CUSTOM=y
CONFIG_FATFS_LFN_HEAP=y
```
